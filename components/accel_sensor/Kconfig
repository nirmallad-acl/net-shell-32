## components/accel_sensor/Kconfig
```kconfig
menu "Accelerometer (ADXL345 + simulator)"

    config ACCEL_I2C_PORT
        int "I2C controller number"
        range 0 1
        default 0
        help
            REQ-HW-03. The ESP32 has two I2C controllers; the sensor uses
            this one in master mode.

    config ACCEL_I2C_SDA_GPIO
        int "I2C SDA GPIO"
        range 0 33
        default 21
        help
            REQ-HW-03. Compile-time checked by a C _Static_assert in
            accel_bus_i2c.c (not by CMake; Kconfig cannot exclude values from a
            range): never UART0 (GPIO 1, 3), never the SPI flash pins (6..11),
            never the strapping pins (0, 2, 5, 12, 15) and never an input-only
            pin. DevKit-C v1 pin 21 is the standard I2C SDA.

    config ACCEL_I2C_SCL_GPIO
        int "I2C SCL GPIO"
        range 0 33
        default 22
        help
            REQ-HW-03. Same checks as ACCEL_I2C_SDA_GPIO.

    config ACCEL_I2C_FREQ_HZ
        int "I2C clock frequency (Hz)"
        range 100000 400000
        default 100000
        help
            100 kHz standard mode (the internal pull-ups are weak, so do not
            raise this without strong external pull-ups).

    config ACCEL_I2C_TIMEOUT_MS
        int "Per-transaction I2C timeout (ms)"
        range 10 100
        default 50
        help
            REQ-FUNC-52. Every transaction passes this finite timeout;
            -1 (wait forever) is never used.

    config ACCEL_PROBE_INTERVAL_MS
        int "Sensor re-probe interval while no sensor is active (ms)"
        range 1000 60000
        default 5000
        help
            OQ-07. The probe task runs one cycle this often while the state
            is not ACTIVE.

    config ACCEL_FAIL_THRESHOLD
        int "Consecutive read failures before falling back to the simulator"
        range 1 10
        default 3
        help
            OQ-07, REQ-FUNC-58.

    config ACCEL_MAX_AGE_MS
        int "Maximum age of a hardware sample at reporting time (ms)"
        range 10 1000
        default 100
        help
            OQ-06, REQ-FUNC-56. A hardware sample older than this is
            reported as ERR sensor_stale; an age exactly at the limit is
            accepted.

    config ACCEL_SIM_XY_MIN_MG
        int "Simulator X/Y minimum (milli-g)"
        range -2000 2000
        default -250

    config ACCEL_SIM_XY_MAX_MG
        int "Simulator X/Y maximum (milli-g)"
        range -2000 2000
        default 250

    config ACCEL_SIM_Z_MIN_MG
        int "Simulator Z minimum (milli-g)"
        range -2000 2000
        default 750

    config ACCEL_SIM_Z_MAX_MG
        int "Simulator Z maximum (milli-g)"
        range -2000 2000
        default 1250
        help
            OQ-04. Simulated readings are uniform integer milli-g inside
            these ranges (a board lying flat reads about +1 g on Z).

    config ACCEL_PROBE_TASK_STACK
        int "Sensor probe task stack (bytes)"
        default 2560
        help
            REQ-MEM-04. Initial value; resize from the measured STACK_HWM.
            Allocated on the heap once at init (static DRAM headroom is
            small, tech_spec.md 2.9).

    config ACCEL_PROBE_TASK_PRIO
        int "Sensor probe task priority"
        range 1 5
        default 1
        help
            REQ-PERF-05. Lowest priority: probing has no deadline.

endmenu
```

## components/ble_cli/Kconfig
```kconfig
menu "BLE CLI"

    config BLE_CLI_TX_QUEUE_DEPTH
        int "Response lines buffered for transmission"
        range 4 16
        default 8
        help
            REQ-PERF-04. Depth of the static TX queue (each item holds one whole
            response line of up to 128 bytes, about 136 bytes of .bss per slot).

    config BLE_CLI_CMD_QUEUE_DEPTH
        int "Parsed commands buffered for the worker"
        range 2 8
        default 4
        help
            Items are 12-byte parse results, not text. A burst beyond this depth
            sets the input-overflow latch and yields one ERR busy
            reason=input_overflow (tech_spec.md 2.5.2).

    config BLE_CLI_WORKER_STACK
        int "CLI worker task stack (bytes)"
        default 4096
        help
            REQ-MEM-04. Initial value; resize from the measured STACK_HWM.
            Allocated on the heap once at init.

    config BLE_CLI_WORKER_PRIO
        int "CLI worker task priority"
        range 1 10
        default 3
        help
            Below the accel session task (4), above the REPL (2).

    config BLE_CLI_DEBUG_TX_LOG
        bool "Log BLECLI_TX / BLECLI_TX_SUPPRESS lines (debug builds only)"
        default n
        help
            REQ-FUNC-61 verification aid: one line per transmitted or suppressed
            response line, with its length only, never its content (REQ-SEC-04).
            Leave n in production builds (test/configs/debug_tx.defaults sets it
            for the test image).

endmenu
```

## components/ble_host/Kconfig
```kconfig
menu "BLE Host (shared NimBLE owner)"

    config BLE_HOST_DEVICE_NAME
        string "GAP / advertised device name (max 10 characters)"
        default "NETSHELL32"
        help
            REQ-FUNC-78. Used for the GAP device name and the Complete Local
            Name in the scan response. Kconfig strings carry no length range,
            so ble_host.c enforces 10 characters with a _Static_assert: when
            the OTA service is armed the scan response holds 2 + name + 18
            bytes and must fit 31 bytes.

    config BLE_HOST_MAX_CLIENTS
        int "Maximum number of GATT clients that may register"
        range 2 4
        default 2
        help
            REQ-FUNC-71. Capacity of the compile-time registration table.
            Today: ble_ota and ble_cli.

    config BLE_HOST_EXEC_TIMEOUT_MS
        int "Total ble_host_exec() bound used by OTA arm/disarm (ms)"
        range 500 2000
        default 1000
        help
            One deadline covering the exec mutex take, the wait for the
            function to start and the 350 ms completion window
            (tech_spec.md 2.3.5). Sized against the worst-case OTA RX
            callback W_OTA of about 350 ms (tech_spec.md 2.4.9).

    config BLE_HOST_ADV_RETRY_MAX_S
        int "Advertising restart retry ceiling (s)"
        range 5 300
        default 30
        help
            On an advertising start failure the host retries after 1, 2, 4,
            8 and 16 s, then every this many seconds (REQ-REL-03).

    config BLE_HOST_INITIATE_SECURITY
        bool "Request pairing from the peripheral as soon as a peer connects"
        default y
        help
            REQ-FUNC-65. Fallback for the R-02 risk: if the existing OTA
            app misbehaves with peripheral-initiated security, set this to
            n. The CLI still works, because its RX characteristic requires
            an encrypted link and Android pairs on the first write. If
            the fallback is taken, REQ-FUNC-65's "no manual bond step" pass
            criterion is NOT met as written and must be accepted by the
            user (record the deviation in docs/ble_cli.md).

    config BLE_HOST_SECURE_DEADLINE_S
        int "Terminate a link that is not encrypted and bonded after (s)"
        range 10 120
        default 60
        help
            Counted from the connection (and from a secure-to-insecure
            change). A fixed bound, not SMP-progress-aware: a pairing that
            starts after about this long minus a few seconds is cut. The
            default 60 s was confirmed at Gate 2 (G2-09), tech_spec.md 2.3.9.

    config BLE_HOST_SEC_INITIATE_RETRIES
        int "Retries of a failed ble_gap_security_initiate()"
        range 0 3
        default 1
        help
            Each retry is made after 2 s while the link generation is
            unchanged and the link is still not secure. The secure deadline
            applies regardless.

endmenu
```

## components/ble_ota/Kconfig
```kconfig
menu "BLE OTA"

    config BLE_OTA_MAX_CHUNK_SIZE
        int "Maximum 0xFB data-chunk payload size (bytes)"
        range 20 512
        default 512
        help
            Compile-time ceiling on the chunkSize field of the 0xFF Set
            Transfer Params command (FR-411). A declared chunkSize above
            this value is rejected before entering RECEIVING, never
            clamped. 512 matches an MTU-517 ATT write exactly
            (tech_spec.md §5.2). This is what makes the per-part
            reassembly buffer a true compile-time bound (NFR-105,
            NFR-203).

            A runtime floor also applies to the chunkSize actually
            declared by the peer at 0xFF, independent of this Kconfig
            ceiling: chunkSize is rejected if it would let a part of up to
            BLE_OTA_MAX_PART_SIZE bytes require more than 256 chunks (the
            fixed size of the per-part coverage bitmap), i.e. whenever
            ceil(BLE_OTA_MAX_PART_SIZE / chunkSize) > 256. This is *not*
            a fixed floor of 20 -- it scales with whatever
            BLE_OTA_MAX_PART_SIZE is configured to, so a smaller
            BLE_OTA_MAX_PART_SIZE raises the effective runtime floor
            above 20 (tech_spec.md §5.4, FR-405, FR-411).

    config BLE_OTA_MAX_PART_SIZE
        int "Maximum part size / reassembly buffer size (bytes)"
        range 4096 65536
        default 65536
        help
            Bound on a single part's total byte length. 0xFC's partLen
            field is 16-bit, so no legal part can exceed 65535 bytes
            (Finding F-3, tech_spec.md §5.3); 65536 is a round 16 flash
            sectors. This is the static size of the per-part reassembly
            buffer (OQ-23, NFR-105, NFR-203) -- never a whole-image
            buffer.

    config BLE_OTA_FAST_MODE
        bool "Enable fast/streamed transfer mode (experimental)"
        default n
        help
            FR-602/FR-603: the fast/streamed transfer mode is optional
            and MUST default to n. With this disabled, no fast-mode code
            or state is present in the binary. Slow/request-driven mode
            (FR-601) is always compiled in regardless of this setting.
            Fast mode is not validated in Phase 4/6 (tech_spec.md §5.7).

    config BLE_OTA_INACTIVITY_TIMEOUT_S
        int "Transfer inactivity timeout (seconds)"
        default 30
        help
            FR-705, OQ-13. If no valid protocol frame arrives within this
            window while a transfer is in progress (SIZE_SET/PARAMS_SET/
            RECEIVING only -- never COMMITTING/INSTALLING), the transfer
            aborts. tech_spec.md §7.1.

    config BLE_OTA_HEALTH_MIN_UPTIME_S
        int "Minimum uptime before an image may be marked valid (seconds)"
        default 30
        help
            FR-802(a), OQ-13. tech_spec.md §7.1.

    config BLE_OTA_HEALTH_DEADLINE_S
        int "Health-verification deadline (seconds)"
        default 120
        help
            FR-805, OQ-13. If the FR-802/803 conjunction is not satisfied
            by this deadline, rollback is actively triggered. tech_spec.md
            §7.1.

    config BLE_OTA_HEALTH_MIN_FREE_HEAP_KB
        int "Minimum free internal heap for a healthy image (KiB)"
        default 40
        help
            FR-804 health check H-5. tech_spec.md §7.2.

    config BLE_OTA_READVERTISE_WINDOW_S
        int "Auto re-advertise window after a disconnect (seconds)"
        default 300
        help
            FR-204, OQ-9. Advertising auto-resumes after a mid-transfer
            disconnect for this long, then stops until a fresh
            "fwupgrade start". tech_spec.md §11 OQ-9.

    config BLE_OTA_REBOOT_DELAY_MS
        int "Delay between the 0x0F success notification and reboot (ms)"
        default 1000
        help
            OQ-20, AC-4. tech_spec.md §7.4.

    config BLE_OTA_SUSPEND_WIFI
        bool "Suspend Wi-Fi STA during an active OTA transfer"
        default y
        help
            NFR-304, NFR-302, OQ-15 (corrected, post-Gate-2 scope). Wi-Fi
            STA is suspended (disconnect + stop) only for the duration of
            an active transfer -- from transfer-begin (0xFD/EVT_BEGIN) to
            transfer-end (success, finalize-failure, or abort) -- and
            restored automatically at transfer-end. "fwupgrade start"
            itself (BLE bring-up + advertising, before any client begins
            transferring data) does NOT suspend Wi-Fi. See
            requirements.md's Gate 2 amendment and tech_spec.md §11 OQ-15.

    config BLE_OTA_ERASE_BONDS_ON_START
        bool "Erase existing BLE bonds on every fwupgrade start"
        default n
        help
            OQ-18. Default is to reuse existing bonds (bonds persist
            across an OTA reboot, OQ-4). tech_spec.md §11 OQ-18.

    config BLE_OTA_REPORT_REJECT_VIA_0X0F
        bool "Report rejected commands via the 0x0F OTA Result notification"
        default y
        help
            FR-411 residual, §8. When enabled, a rejected command (bad
            length, out-of-sequence opcode, oversized chunk, etc.) is
            answered with a free-form 0x0F text in addition to the
            WARN/ERROR log line. Disable to fall back to silent-refusal
            plus log only, if the real Android app is found to mishandle
            an early 0x0F (tech_spec.md §8 residual risk).

    config BLE_OTA_ROLLBACK_LOOP_LIMIT
        int "Rollback count before the class-D lenient escape applies"
        default 2
        help
            OQ-19. Applies only when every failed health check is class D
            (H-2/H-3/H-5) -- tech_spec.md §7.3.1.

    config BLE_OTA_ROLLBACK_HARD_LIMIT
        int "Absolute rollback ceiling for class-R failures"
        default 8
        help
            OQ-19, NFR-101. Defence-in-depth only: a class-R failure
            (H-1/H-4) is never marked valid regardless of this counter
            (RB-INV) -- tech_spec.md §7.3.1.

    config BLE_OTA_DRAIN_TIMEOUT_MS
        int "ABORTING_DRAIN watchdog (ms)"
        default 3000
        help
            tech_spec.md §5.9.6. Set below both the 5 s task WDT and the
            4 s BLE supervision timeout so FWUPG_DRAIN_TIMEOUT is
            diagnostic, not posthumous.

    config BLE_OTA_VERBOSE_CHUNK_LOG
        bool "Compile in per-chunk/per-frame DEBUG and VERBOSE logging"
        default n
        help
            tech_spec.md §4.2.1 (verification step V-1) / §9. Only needs
            enabling if V-1 shows the optimiser leaves per-chunk DEBUG /
            VERBOSE format strings linked into .rodata despite
            CONFIG_LOG_MAXIMUM_LEVEL_INFO. Leave n for production builds.

    config BLE_OTA_WORKER_TASK_STACK
        int "Flash worker task stack size (bytes)"
        default 4096
        help
            NFR-201, NFR-204. Initial value; resize from the measured
            high-water mark once available.

    config BLE_OTA_WORKER_TASK_PRIO
        int "Flash worker task priority"
        default 4
        help
            NFR-204. Above the REPL (2) so a transfer is never starved by
            console I/O; far below the BLE host/controller (21/23) so
            radio timing is never delayed by flash work. tech_spec.md
            §3.4.

endmenu
```
