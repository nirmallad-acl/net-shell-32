## components/diag_cmds/Kconfig
```kconfig
menu "Diagnostics commands (serial and BLE)"

    config DIAG_REBOOT_GUARD_TIMEOUT_MS
        int "Reboot guard total timeout (ms)"
        range 500 1200
        default 1000
        help
            REQ-FUNC-29/31, tech_spec.md 2.4.4. Total bound of the
            ble_host_exec() round trip that atomically checks "no OTA in
            flight". 350 ms of it is the completion window; the rest is the
            window for the host task to start the check, sized against the
            worst-case OTA RX callback of about 350 ms. The 1200 ms cap
            keeps esp_restart() within 1440 ms of the command, inside the
            1.5 s bound.

    config DIAG_REBOOT_ACK_WAIT_MS
        int "Maximum wait for the reboot acknowledgement to leave the device (ms)"
        range 100 1000
        default 1000
        help
            OQ-12. The actual wait is further limited by the single
            command deadline (command time + 1410 ms).

    config DIAG_ACCEL_TASK_STACK
        int "accel_xyz session task stack (bytes)"
        default 3072
        help
            REQ-MEM-04. Initial value; resize from the measured STACK_HWM.
            Allocated on the heap once at init.

    config DIAG_ACCEL_TASK_PRIO
        int "accel_xyz session task priority"
        range 1 10
        default 4
        help
            Above the BLE CLI worker (3) so slot deadlines are not delayed
            by response handling, below the BLE host (21) and controller (23).
            REQ-PERF-02.

endmenu
```

## main/Kconfig.projbuild
```kconfig
menu "NETSHELL32-5 test hooks (BUILD-TEST IMAGES ONLY - never enable in a shipped image)"

    config NS5_TEST_FAIL_HOST_INIT
        bool "Force ble_host_start() to fail before touching the radio"
        default n
        help
            Test hook H-8 (TC-INT-01). The only error line of the boot is then
            BLECLI_HOST_FAIL err=test_injected; the REPL and the serial
            commands must still work and "fwupgrade start" must refuse with
            outcome=host_unavailable. Must stay n in every shipped image.

    config NS5_TEST_STALL_HOST
        bool "Register the ns5_stall <ms> console command"
        default n
        help
            Test hook H-10 (TC-REB-05, V-10). The command blocks the NimBLE
            host task with vTaskDelay (never a busy loop) for the given
            time. Must stay n in every shipped image.

    config NS5_TEST_AUTORUN
        bool "Run a scripted command list on the console after the prompt"
        default n
        help
            Test hook H-11 fallback, used when the host-side capture script
            cannot send commands. After the REPL started and the BLE host was
            brought up, the commands in NS5_TEST_AUTORUN_CMDS are run one by
            one through esp_console_run(), 2 s apart, starting 5 s after boot
            completes. Must stay n in every shipped image.

    config NS5_TEST_AUTORUN_CMDS
        string "Semicolon-separated autorun command list"
        depends on NS5_TEST_AUTORUN
        default "hw_version;fw_version;reboot_reason;accel_xyz;fwupgrade status"
        help
            Each entry is run exactly as if typed at the prompt.

endmenu
```
